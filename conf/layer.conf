## conf/layer.conf
```bitbake
# SPDX-License-Identifier: MIT
# Copyright 2022 BG Networks, Inc.

BBPATH .= ":${LAYERDIR}"

LAYERSERIES_COMPAT_bgnetworks = " honister kirkstone"

BGNETWORKS_LAYERDIR := "${LAYERDIR}"
```
